// gesture_classifier.ino -- recognise hand gestures on the Arduino Nano 33 BLE Sense.
//
// Hold the board flat in your hand (components up, USB cable towards your
// wrist) and make one of the gestures the model was trained on. The board
// detects the start of the movement, records one second of IMU data, runs the
// neural network and
//   * prints the result on the Serial Monitor (115200 baud), and
//   * lights the RGB LED: punch=red, lift=green, wave=blue, circle=yellow,
//     twist=purple, not sure=off.
//
// The network itself is in model_data.h, generated by notebook 05.
// At start-up the sketch runs a self-test: it classifies a gesture stored in
// model_data.h and checks that the board computes exactly what Python computed.

// ===== 1. Which board do you have? =========================================
// Look at the bottom of your board / the box:
//   1 = "Nano 33 BLE Sense"       (IMU: LSM9DS1)    -> library Arduino_LSM9DS1
//   2 = "Nano 33 BLE Sense Rev2"  (IMU: BMI270)     -> library Arduino_BMI270_BMM150
#define BOARD_REVISION 1

// ===== 2. Which network do you want to run? ================================
//   8  = int8 (quantized) network  -- 4x smaller
//   32 = float32 network           -- the same network before quantization
#define MODEL_PRECISION 8

// Below this probability we answer "not sure" instead of guessing.
#define CONFIDENCE_THRESHOLD 0.6f

#if BOARD_REVISION == 2
#include <Arduino_BMI270_BMM150.h>
#else
#include <Arduino_LSM9DS1.h>
#endif

#include "model_data.h"
#include "edge_nn.h"
#include "gesture_recorder.h"

GestureRecorder recorder;
static float features[MODEL_N_FEATURES];

static void runModel(const float* feats, float* logits) {
#if MODEL_PRECISION == 8
  edge_nn::forward_int8(feats, logits);
#else
  edge_nn::forward_float(feats, logits);
#endif
}

// The RGB LED is "active low": LOW switches a colour on.
static void setLed(int gesture) {
  //                             punch  lift   wave   circle twist
  static const bool red[]   = { true,  false, false, true,  true  };
  static const bool green[] = { false, true,  false, true,  false };
  static const bool blue[]  = { false, false, true,  false, true  };
  const bool on = gesture >= 0 && gesture < 5;
  digitalWrite(LEDR, on && red[gesture] ? LOW : HIGH);
  digitalWrite(LEDG, on && green[gesture] ? LOW : HIGH);
  digitalWrite(LEDB, on && blue[gesture] ? LOW : HIGH);
}

static void printLogits(const char* label, const float* v) {
  Serial.print(label);
  for (int j = 0; j < MODEL_N_CLASSES; ++j) {
    Serial.print(' ');
    Serial.print(v[j], 4);
  }
  Serial.println();
}

// Classify the gesture stored in model_data.h and compare with Python.
static void selfTest() {
  float logits[MODEL_N_CLASSES];
  edge_nn::normalize(kTestWindow, features);
  runModel(features, logits);
#if MODEL_PRECISION == 8
  const float* expected = kTestLogitsInt8;
  const float tolerance = 1e-4f;   // int8 math should match (almost) exactly
#else
  const float* expected = kTestLogitsFloat;
  const float tolerance = 1e-3f;   // float sums may round slightly differently
#endif
  float max_diff = 0.0f;
  for (int j = 0; j < MODEL_N_CLASSES; ++j) {
    max_diff = fmaxf(max_diff, fabsf(logits[j] - expected[j]));
  }
  printLogits("# self-test logits (board): ", logits);
  printLogits("# self-test logits (Python):", expected);
  Serial.print("# self-test: true gesture = ");
  Serial.print(kGestureNames[kTestLabel]);
  Serial.print(", predicted = ");
  Serial.print(kGestureNames[edge_nn::argmax(logits, MODEL_N_CLASSES)]);
  Serial.print(", max difference = ");
  Serial.print(max_diff, 6);
  Serial.println(max_diff <= tolerance ? "  -> PASS" : "  -> FAIL (is model_data.h up to date?)");

  // Speed test: average over 100 runs.
  const unsigned long t0 = micros();
  for (int k = 0; k < 100; ++k) runModel(features, logits);
  const unsigned long dt = micros() - t0;
  Serial.print("# inference time: ");
  Serial.print(dt / 100.0f, 1);
  Serial.println(" us per gesture");
}

void setup() {
  Serial.begin(115200);
  const unsigned long t0 = millis();
  while (!Serial && millis() - t0 < 4000) {}   // wait for the Serial Monitor (max 4 s)

  pinMode(LEDR, OUTPUT);
  pinMode(LEDG, OUTPUT);
  pinMode(LEDB, OUTPUT);
  pinMode(LED_BUILTIN, OUTPUT);
  setLed(-1);

  if (!IMU.begin()) {
    Serial.println("# ERROR: IMU not found. Is BOARD_REVISION set correctly?");
    while (true) {
      digitalWrite(LED_BUILTIN, !digitalRead(LED_BUILTIN));
      delay(200);
    }
  }

  Serial.print("# gesture_classifier: ");
  Serial.print(MODEL_PRECISION == 8 ? "int8" : "float32");
  Serial.print(" network, ");
  Serial.print(MODEL_N_LAYERS);
  Serial.print(" layers, input ");
  Serial.print(MODEL_N_FEATURES);
  Serial.print(", gestures:");
  for (int j = 0; j < MODEL_N_CLASSES; ++j) {
    Serial.print(' ');
    Serial.print(kGestureNames[j]);
  }
  Serial.println();
  selfTest();
  Serial.println("# ready -- make a gesture!");
}

void loop() {
  digitalWrite(LED_BUILTIN, recorder.isRecording() ? HIGH : LOW);
  if (!recorder.update()) return;           // no complete gesture yet

  float logits[MODEL_N_CLASSES], probs[MODEL_N_CLASSES];
  edge_nn::normalize(recorder.window(), features);
  const unsigned long t0 = micros();
  runModel(features, logits);
  const unsigned long dt = micros() - t0;
  edge_nn::softmax(logits, probs, MODEL_N_CLASSES);
  const int best = edge_nn::argmax(probs, MODEL_N_CLASSES);
  const bool sure = probs[best] >= CONFIDENCE_THRESHOLD;

  setLed(sure ? best : -1);
  Serial.print(sure ? kGestureNames[best] : "not sure");
  Serial.print("  (");
  Serial.print(100.0f * probs[best], 0);
  Serial.print("% ");
  Serial.print(kGestureNames[best]);
  Serial.print(")  [");
  for (int j = 0; j < MODEL_N_CLASSES; ++j) {
    Serial.print(kGestureNames[j]);
    Serial.print('=');
    Serial.print(probs[j], 2);
    Serial.print(j + 1 < MODEL_N_CLASSES ? " " : "");
  }
  Serial.print("]  ");
  Serial.print(dt);
  Serial.println(" us");
}
